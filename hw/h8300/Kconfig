## hw/h8300/Kconfig
```kconfig
config H8300
    bool

config H83069
    bool
    select H8300
    select RENESAS_TMR8
    select RENESAS_TMR16
    select RENESAS_SCI

config H8S2674
    bool
    select H8300
    select RENESAS_TMR8
    select RENESAS_TPU
    select RENESAS_SCI

config H8300_KANEBEBE
    bool
    select H83069
    select NE2000_LOCAL

config H8300_EDOSK2674
    bool
    select H8S2674
    select PFLASH_CFI01
    select SMC91C111
```
